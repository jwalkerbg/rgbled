## main/Kconfig.projbuild
```kconfig
menu "Application Configuration"

    orsource "$IDF_PATH/examples/common_components/env_caps/$IDF_TARGET/Kconfig.env_caps"

    config RGBLED_GPIO
        int "RGBLED_GPIO: RGB LED GPIO number"
        range ENV_GPIO_RANGE_MIN ENV_GPIO_OUT_RANGE_MAX
        default 8 if IDF_TARGET_ESP32C3 || IDF_TARGET_ESP32H2 || IDF_TARGET_ESP32C2
        default 18 if IDF_TARGET_ESP32S2
        default 48 if IDF_TARGET_ESP32S3
        default 5
        help
            GPIO number (IOxx) to turn on and off or the RMT signal for the addressable LED.
            Some GPIOs are used for other purposes (flash connections, etc.) and cannot be used to blink.

    config LED_STEP_INTERVAL
        int "LED_STEP_INTERVAL: Step interval in [ms]"
        range 10 3600000
        default 10
        help
            Define the stepping period in milliseconds for LED fading down ot lighting up.

    config LED_MIN_INTENSITY
        int "LED_MIN_INTENSITY: Minimum intensity of LED light"
        range 0 254
        default 0
        help
            Define the minimum intensity of the LED as 8-bit unsigned value.

    config LED_MAX_INTENSITY
        int "LED_MAX_INTENSITY: Maximum intensity of LED light"
        range 2 255
        default 100
        help
            Define the maximum intensity of the LED as 8-bit unsigned value.

    config LED_TOTAL_CYCLES
        int "LED_TOTAL_CYCLES: How many min-max cycles to be performed before restart"
        range 5 32767
        default 100
        help
            Define how cycles of rising up / fading down will perform the LEDs befor the system will be restarted.

    config RESTART_DELAY
        int "RESTART_DELAY: Delay after leds are turned off"
        range 2 60
        default 10
        help
            Define time interval between switch off LEDs and restarting.

endmenu
```
